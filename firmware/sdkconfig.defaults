## firmware/sdkconfig.defaults
```kconfig
# RadiaLog power management configuration
# Enable ESP-IDF power management framework
CONFIG_PM_ENABLE=y

# Enable FreeRTOS tickless idle (allows light sleep during idle)
CONFIG_FREERTOS_USE_TICKLESS_IDLE=y

# Allow automatic light sleep when all tasks are idle
CONFIG_PM_POWER_DOWN_CPU_IN_LIGHT_SLEEP=y
```
